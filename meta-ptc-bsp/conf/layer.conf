## meta-ptc-bsp/conf/machine/zynqmp-ptc.conf
```bitbake
#@TYPE: Machine
#@NAME: zynqmp-ptc
#@DESCRIPTION: Machine configuration for the zynqmp-ptc boards.

#### Preamble
MACHINEOVERRIDES =. "${@['', 'zynqmp-ptc:']['zynqmp-ptc' !='${MACHINE}']}"
#### Regular settings follow

# Yocto device-tree variables
YAML_CONSOLE_DEVICE_CONFIG:pn-device-tree ?= "psu_uart_0"
YAML_MAIN_MEMORY_CONFIG:pn-device-tree ?= "psu_ddr_0"
DT_PADDING_SIZE:pn-device-tree ?= "0x1000"
DTC_FLAGS:pn-device-tree ?= ""
YAML_DT_BOARD_FLAGS ?= "{BOARD template}"

# Yocto u-boot-xlnx variables
UBOOT_MACHINE ?= "xilinx_zynqmp_virt_defconfig"

# Yocto PMUFW variables
YAML_COMPILER_FLAGS:append:pn-pmu-firmware = " "
YAML_SERIAL_CONSOLE_STDIN:pn-pmu-firmware ?= "psu_uart_0"
YAML_SERIAL_CONSOLE_STDOUT:pn-pmu-firmware ?= "psu_uart_0"

# Yocto FSBL variables
YAML_SERIAL_CONSOLE_STDIN:pn-fsbl-firmware ?= "psu_uart_0"
YAML_SERIAL_CONSOLE_STDOUT:pn-fsbl-firmware ?= "psu_uart_0"

# Serial Console Settings
SERIAL_CONSOLES ?= "115200;ttyPS0"
YAML_SERIAL_CONSOLE_BAUDRATE ?= "115200"

# Yocto arm-trusted-firmware(TF-A) variables
TFA_CONSOLE ?= "cadence"
TFA_BL33_LOAD ?= "0x8000000"

# Set DDR Base address for u-boot-xlnx-scr variables
DDR_BASEADDR ?= "0x0"
SKIP_APPEND_BASEADDR ?= "0"

# Yocto KERNEL Variables
UBOOT_ENTRYPOINT  ?= "0x200000"
UBOOT_LOADADDRESS ?= "0x200000"

# Yocto MACHINE_FEATURES Variable
MACHINE_FEATURES += "mali400 vcu"

# Yocto IMAGE_FEATURES Variable
#MACHINE_HWCODECS = "libvcu-omxil"
#IMAGE_FEATURES += "hwcodecs"

# Required generic machine inclusion
require conf/machine/zynqmp-generic.conf

# This is an 'XSCT' based BSP
XILINX_XSCT_VERSION = "2025.1"
XILINX_WITH_ESW = "xsct"

# Add system XSA
HDF_URI = "file:///workdir/meta-ptc/meta-ptc-bsp/hw-description/Mercury_XU5_PE1.xsa"
HDF_URI[sha256sum] = "495798ac3115c450f0eb3297310159426cdaa42c7ae039765c4faafa4995ca08"
HDF_URI[S] = "${WORKDIR}/workdir/meta-ptc/meta-ptc-bsp/hw-description"

#### No additional settings should be after the Postamble
#### Postamble
PACKAGE_EXTRA_ARCHS:append = "${@['', ' zynqmp_ptc']['zynqmp-ptc' != '${MACHINE}']}"
```

## meta-ptc-software/conf/distro/ptc-distro.conf
```bitbake
# meta-ptc/conf/distro/ptc-distro.conf

DISTRO = "ptc-distro"
DISTRO_NAME = "PTC Minimal Embedded Linux"
DISTRO_VERSION = "1.0.0"
DISTRO_CODENAME = "lean"

INIT_MANAGER = "systemd"
DISTRO_FEATURES_BACKFILL_CONSIDERED += "sysvinit"
VIRTUAL-RUNTIME_initscripts = ""

PACKAGE_CLASSES ?= "package_ipk"

USE_NLS = "no"
IMAGE_LINGUAS = ""

DISTRO_FEATURES = " \
    systemd \
    ipv4 \
    ipv6 \
    usrmerge \
"

DISTRO_FEATURES:remove = " \
    alsa \
    bluetooth \
    nfc \
    3g \
    nfs \
    zeroconf \
    x11 \
    wayland \
    opengl \
    vulkan \
    pulseaudio \
"

VOLATILE_LOG_DIR = "yes"
```

## meta-ptc-software/conf/distro/ptc-micro-distro.conf
```bitbake
# meta-custom/conf/distro/ptc-micro-distro.conf

DISTRO = "ptc-micro-distro"
DISTRO_NAME = "PTC Ultra-Minimal BusyBox Linux"
DISTRO_VERSION = "1.0.0"
DISTRO_CODENAME = "micro"

INIT_MANAGER = "mdev-busybox"

VIRTUAL-RUNTIME_initscripts = "initscripts"
VIRTUAL-RUNTIME_init_manager = "busybox"
VIRTUAL-RUNTIME_login_manager = "busybox"
VIRTUAL-RUNTIME_dev_manager = "busybox-mdev"

PACKAGE_CLASSES ?= "package_ipk"

USE_NLS = "no"
IMAGE_LINGUAS = ""

DISTRO_FEATURES = " \
    sysvinit \
    ipv4 \
    ipv6 \
    usrmerge \
"

DISTRO_FEATURES_BACKFILL_CONSIDERED += "systemd"

DISTRO_FEATURES:remove = " \
    systemd \
    alsa \
    bluetooth \
    nfc \
    3g \
    nfs \
    zeroconf \
    x11 \
    wayland \
    opengl \
    vulkan \
    pulseaudio \
"

VOLATILE_LOG_DIR = "yes"
```
